## tp2bmc/package/tailscale/Config.in
```kconfig
config BR2_PACKAGE_TAILSCALE
    bool "Tailscale daemon"
    depends on BR2_PACKAGE_HOST_GO_TARGET_ARCH_SUPPORTS
    help
        This is tailscale
```
